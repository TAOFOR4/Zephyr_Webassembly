## zephyr/hello_world/build/Kconfig/arch/Kconfig
```kconfig
# Load arch Kconfig descriptions.
osource "/home/tao/zephyrproject/zephyr/arch/x86/Kconfig"
osource "/home/tao/zephyrproject/zephyr/arch/xtensa/Kconfig"
osource "/home/tao/zephyrproject/zephyr/arch/sparc/Kconfig"
osource "/home/tao/zephyrproject/zephyr/arch/riscv/Kconfig"
osource "/home/tao/zephyrproject/zephyr/arch/posix/Kconfig"
osource "/home/tao/zephyrproject/zephyr/arch/nios2/Kconfig"
osource "/home/tao/zephyrproject/zephyr/arch/mips/Kconfig"
osource "/home/tao/zephyrproject/zephyr/arch/arm64/Kconfig"
osource "/home/tao/zephyrproject/zephyr/arch/arm/Kconfig"
osource "/home/tao/zephyrproject/zephyr/arch/arc/Kconfig"
```
